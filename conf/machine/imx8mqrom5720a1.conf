## conf/machine/imx8mqrom5720a1.conf
```bitbake
#MACHINEOVERRIDES =. "mx8:mx8m:mx8mq:"
MACHINEOVERRIDES =. "mx8mq-nxp-bsp:"
require conf/machine/imx8mqevk.conf

# Optee parameters
#OPTEE_PLATFORM_FLAVOR = "mx8mqevk"
OPTEE_PLATFORM_FLAVOR = "mx8mqrom5720a1"
PLATFORM_FLAVOR:imx8mqrom5720a1 = "${OPTEE_PLATFORM_FLAVOR}"

KERNEL_DEVICETREE += "freescale/imx8mq-rom5720-a1.dtb"

UBOOT_CONFIG ??= "2G"
UBOOT_CONFIG[2G] = "imx8mq_rom5720a1_2G_config,sdcard"

UBOOT_DTB_NAME = "imx8mq-rom5720-a1.dtb"
```
